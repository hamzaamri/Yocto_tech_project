## meta-tech-bsp/conf/machine/rpi3-tech.conf
```bitbake
#=============================================
# RASPBERRYPI3-64 MACHINE FOR TECHLEEF PROJECT
#=============================================
require conf/machine/raspberrypi3-64.conf

MACHINEOVERRIDES .= ":raspberrypi3-64"

# Remove unecessary machine features
MACHINE_FEATURES:remove = "touchscreen bluetooth wifi screen alsa"
MACHINE_EXTRA_RRECOMMENDS = " "
MACHINE_FEATURES_BACKFILL = " "
MACHINE_FEATURES_BACKFILL_CONSIDERED = " "
MACHINE_ESSENTIAL_EXTRA_RDEPENDS = " "
MACHINE_EXTRA_RDEPENDS = " "
```
