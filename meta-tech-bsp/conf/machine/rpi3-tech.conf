## meta-tech-distro/conf/distro/tech-distro.conf
```bitbake
#===========================
# DISTRO FOR TECHLEEF PROJECT
#============================
DISTRO_Name = "tech-distro"
DISTRO_VERSION = "0.1"

# Remove unecessary distro features
DISTRO_FEATURES:remove = "alsa bluetooth wifi pulseaudio pci 3g x11 nfs ipv4"
DISTRO_RRECOMMENDS = ""
DISTRO_FEATURES_BACKFILL:remove = "pulseaudios"
DISTRO_FEATURES_NATIVE:remove = "x11"

# Define busybox as preferred provider
PREFERRED_PROVIDER_tar = "busybox"
PREFERRED_PROVIDER_coreutils = "busybox"

# Enable systemd
INIT_MANAGER = "systemd"

# Prevent enabling suffix on .bbappend
TCLIBCAPPEND = ""

# Compiler optimization flags
FULL_OPTIMIZATION =  '-O2 -pipe ${DEBUG_FLAGS}'
```
