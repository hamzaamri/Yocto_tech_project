## Kas/build/conf/bblayers.conf
```bitbake
# standard
POKY_BBLAYERS_CONF_VERSION = "2"
BBPATH = "${TOPDIR}"
BBFILES ?= ""

BBLAYERS ?= " \
    ${TOPDIR}/../../meta-tech-bsp \
    ${TOPDIR}/../../meta-tech-distro \
    ${TOPDIR}/../../meta-tech-prj \
    ${TOPDIR}/../../../layers/meta-raspberrypi \
    ${TOPDIR}/../../../layers/oe-core/meta"
BBPATH ?= "${TOPDIR}"
BBFILES ??= ""
```

## Kas/build/conf/local.conf
```bitbake
# custom-local-conf
ACCEPT_FSL_EULA = "1"
DL_DIR = "/home/hamza/yocto/work/downloads"
SSTATE_DIR = "/home/hamza/yocto/work/sstate-cache"
BB_CURRENT_MC = "default"
SPDX_GENERATE = "0"
INHERIT:remove = "create-spdx"
INHERIT += "buildhistory"
BUILDHISTORY_COMMIT = "1"
INHERIT += "cve-check"
PREFERRED_PROVIDER_tar = "busybox"
PREFERRED_PROVIDER_coreutils = "busybox"
INCOMPATIBLE_LICENSE = "GPL-3.0* LGPL-3.0* AGPL-3.0*"

MACHINE ??= "qemux86-64"
DISTRO ??= "rpi3-distro"
BBMULTICONFIG ?= ""
```

## meta-tech-bsp/conf/layer.conf
```bitbake
# We have a conf and classes directory, add to BBPATH
BBPATH .= ":${LAYERDIR}"

# We have recipes-* directories, add to BBFILES
BBFILES += "${LAYERDIR}/recipes-*/*/*.bb \
            ${LAYERDIR}/recipes-*/*/*.bbappend"

BBFILE_COLLECTIONS += "meta-tech-bsp"
BBFILE_PATTERN_meta-tech-bsp = "^${LAYERDIR}/"
BBFILE_PRIORITY_meta-tech-bsp = "6"

LAYERDEPENDS_meta-tech-bsp = "core"
LAYERSERIES_COMPAT_meta-tech-bsp = "scarthgap"
```

## meta-tech-distro/conf/distro/rpi3-distro.conf
```bitbake
require conf/distro/defaultsetup.conf

INIT_MANAGER = "systemd"

DISTRO_FEATURES:remove = "alsa bluetooth wifi pulseaudio pci 3g"
```

## meta-tech-distro/conf/layer.conf
```bitbake
# We have a conf and classes directory, add to BBPATH
BBPATH .= ":${LAYERDIR}"

# We have recipes-* directories, add to BBFILES
BBFILES += "${LAYERDIR}/recipes-*/*/*.bb \
            ${LAYERDIR}/recipes-*/*/*.bbappend"

BBFILE_COLLECTIONS += "meta-tech-distro"
BBFILE_PATTERN_meta-tech-distro = "^${LAYERDIR}/"
BBFILE_PRIORITY_meta-tech-distro = "6"

LAYERDEPENDS_meta-tech-distro = "core"
LAYERSERIES_COMPAT_meta-tech-distro = "scarthgap"
```

## meta-tech-prj/conf/layer.conf
```bitbake
# We have a conf and classes directory, add to BBPATH
BBPATH .= ":${LAYERDIR}"

# We have recipes-* directories, add to BBFILES
BBFILES += "${LAYERDIR}/recipes-*/*/*.bb \
            ${LAYERDIR}/recipes-*/*/*.bbappend"

BBFILE_COLLECTIONS += "meta-tech-prj"
BBFILE_PATTERN_meta-tech-prj = "^${LAYERDIR}/"
BBFILE_PRIORITY_meta-tech-prj = "6"

LAYERDEPENDS_meta-tech-prj = "core"
LAYERSERIES_COMPAT_meta-tech-prj = "scarthgap"
```
